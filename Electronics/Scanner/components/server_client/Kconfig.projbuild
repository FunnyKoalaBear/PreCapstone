## Electronics/Scanner/components/server_client/Kconfig.projbuild
```kconfig
menu "Factory Server"

    config FACTORY_SERVER_URL
        string "Factory base URL (no trailing slash)"
        default "http://192.168.8.155:8080"

    config FACTORY_SERVER_SCAN_PATH
        string "Path that receives scans"
        default "/api/scan/"

    config FACTORY_SERVER_PREVIEW_PATH
        string "Path that previews a scan without saving it"
        default "/api/scan-preview/"

    config FACTORY_API_KEY
        string "API key sent in the X-API-Key header"
        default ""

    config FACTORY_SERVER_TIMEOUT_MS
        int "HTTP timeout (ms)"
        default 5000

endmenu
```

## Electronics/Setter/components/server_client/Kconfig.projbuild
```kconfig
menu "Factory Server"

    config FACTORY_SERVER_URL
        string "Factory base URL (no trailing slash)"
        default "http://192.168.8.155:8080"

    config FACTORY_SERVER_SCAN_PATH
        string "Path that receives scans"
        default "/api/scan/"

    config FACTORY_SERVER_ITEMS_PATH
        string "Path that lists items still needing a tag"
        default "/api/assignable-items/"

    config FACTORY_SERVER_ASSIGN_PATH
        string "Path that links a tag to an item"
        default "/api/assign/"

    config FACTORY_SERVER_DRAWING_PATH
        string "Path of an item's drawing as screen pixels (%d = item id)"
        default "/api/items/%d/drawing-pixels/"

    config FACTORY_API_KEY
        string "API key sent in the X-API-Key header"
        default ""

    config FACTORY_SERVER_TIMEOUT_MS
        int "HTTP timeout (ms)"
        default 5000

endmenu
```

## Electronics/Setter/components/wifi/Kconfig.projbuild
```kconfig
menu "Scanner WiFi"

    config SCANNER_WIFI_SSID
        string "WiFi network name (SSID)"
        default ""

    config SCANNER_WIFI_PASSWORD
        string "WiFi password (empty for an open network)"
        default ""

    config SCANNER_WIFI_CONNECT_TIMEOUT_MS
        int "How long init() waits for a connection (ms)"
        default 15000

endmenu

#This will add to the options showing up at idf.py menuconfig 
```
